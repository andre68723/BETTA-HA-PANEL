## components/esp_cam_sensor/sensors/ov02c10/Kconfig.ov02c10
```kconfig
menuconfig CAMERA_OV02C10
    bool "OV02C10"
    default n
    depends on SOC_MIPI_CSI_SUPPORTED || SOC_LCDCAM_CAM_SUPPORTED
    help
        Enable support for the OV02C10 CMOS image sensor.

if CAMERA_OV02C10
    menu "Auto detect OV02C10"
        config CAMERA_OV02C10_AUTO_DETECT_DVP_INTERFACE_SENSOR
            bool "Detect for DVP interface sensor"
            default n
            depends on SOC_LCDCAM_CAM_SUPPORTED
            help
                When enabled, the OV02C10 sensor will be automatically detected
                and initialized on the DVP interface at startup without requiring
                manual detection call(ov02c10_detect) in your application.

        config CAMERA_OV02C10_AUTO_DETECT_MIPI_INTERFACE_SENSOR
            bool "Detect for MIPI CSI interface sensor"
            default y
            depends on SOC_MIPI_CSI_SUPPORTED
            help
                When enabled, the OV02C10 sensor will be automatically detected
                and initialized on the MIPI CSI interface at startup without requiring
                manual detection call(ov02c10_detect) in your application.
    endmenu

    menu "Choose supported formats for MIPI CSI interface"
        depends on SOC_MIPI_CSI_SUPPORTED
        config CAMERA_OV02C10_MIPI_RAW10_1288X728_30FPS
            bool "MIPI 1-lane, 24M input, 1288x728  30fps, RAW10"
            default n
            help
                RAW10 color format at 1288x728 resolution (HD) with 30fps framerate.
                Requires MIPI CSI-2 2-lane interface with 24MHz input clock.

        config CAMERA_OV02C10_MIPI_RAW10_1920X1080_30FPS_1_LANE
            bool "MIPI 1-lane, 24M input, 1920x1080 30fps, RAW10"
            default n
            help
                RAW10 color format at 1920x1080 resolution (FHD) with 30fps framerate.
                Requires MIPI CSI-2 1-lane interface with 24MHz input clock.

        config CAMERA_OV02C10_MIPI_RAW10_1920X1080_30FPS_2_LANE
            bool "MIPI 2-lane, 24M input, 1920x1080 30fps, RAW10"
            default n
            help
                RAW10 color format at 1920x1080 resolution (FHD) with 30fps framerate.
                Requires MIPI CSI-2 2-lane interface with 24MHz input clock.
    endmenu

    choice CAMERA_OV02C10_MIPI_DEFAULT_FMT
        prompt "Select default output format for MIPI CSI interface"
        default CAMERA_OV02C10_MIPI_DEFAULT_FMT_RAW10_1920X1080_30FPS_1_LANE
        depends on SOC_MIPI_CSI_SUPPORTED
        help
            This option allows you to select the default video format for the OV02C10 sensor
            when it is initialized on the MIPI CSI interface. The selected format will be used
            when the sensor is detected and initialized, and can be changed later when the
            sensor is in stream off state.

        config CAMERA_OV02C10_MIPI_DEFAULT_FMT_RAW10_1288X728_30FPS
            bool "MIPI 1-lane, 24M input,  1288x728  30fps, RAW10"
            depends on CAMERA_OV02C10_MIPI_RAW10_1288X728_30FPS

        config CAMERA_OV02C10_MIPI_DEFAULT_FMT_RAW10_1920X1080_30FPS_1_LANE
            bool "MIPI 1-lane, 24M input, 1920x1080  30fps, RAW10"
            depends on CAMERA_OV02C10_MIPI_RAW10_1920X1080_30FPS_1_LANE

        config CAMERA_OV02C10_MIPI_DEFAULT_FMT_RAW10_1920X1080_30FPS_2_LANE
            bool "MIPI 2-lane, 24M input, 1920x1080  30fps, RAW10"
            depends on CAMERA_OV02C10_MIPI_RAW10_1920X1080_30FPS_2_LANE
    endchoice # CAMERA_OV02C10_MIPI_DEFAULT_FMT

    config CAMERA_OV02C10_MIPI_IF_FORMAT_INDEX_DEFAULT
        int
        depends on SOC_MIPI_CSI_SUPPORTED
        default 0 if CAMERA_OV02C10_MIPI_DEFAULT_FMT_RAW10_1288X728_30FPS
        default 1 if CAMERA_OV02C10_MIPI_DEFAULT_FMT_RAW10_1920X1080_30FPS_1_LANE
        default 2 if CAMERA_OV02C10_MIPI_DEFAULT_FMT_RAW10_1920X1080_30FPS_2_LANE

        help
            Sets the default configuration for the MIPI CSI interface.
            Use query_support_formats() API to get more format options.

    config CAMERA_OV02C10_ABSOLUTE_GAIN_LIMIT
            int "Maximum absolute gain limit (x1000)"
            default 66016
            range 4000 126016
            help
                Set the maximum gain limit that can be applied by upper-level applications.

                Value is gain multiplied by 1000 to avoid floating-point arithmetic:
                - 4000 = 4x gain (minimum)
                - 66016 = 66.016x gain (default)
                - 126016 = 126.016x gain (maximum)

                Lower values reduce noise but may limit low-light performance.
                Higher values improve low-light sensitivity but increase noise and
                may cause sensor overheating.

                Recommended values:
                - 32000 (32x): Good balance for most applications
                - 66016 (66x): Enhanced low-light performance
                - 126016 (126x): Maximum sensitivity (use with caution)

    choice CAMERA_OV02C10_ABS_GAIN_MAP_PRIORITY
        prompt "Gain control priority"
        default CAMERA_OV02C10_DIG_GAIN_PRIORITY
        help
            Select the gain control strategy to balance image quality and noise.

            The gain mapping affects noise levels and brightness transition smoothness.
            Analog gain generally produces less noise than digital gain, but digital
            gain provides smoother brightness transitions.

        config CAMERA_OV02C10_ANA_GAIN_PRIORITY
            bool "Analog gain priority"
            help
                Prioritize analog gain over digital gain for noise reduction.
        config CAMERA_OV02C10_DIG_GAIN_PRIORITY
            bool "Digital gain priority"
            help
                Prioritize digital gain over analog gain for smooth transitions.
    endchoice # CAMERA_OV02C10_ABS_GAIN_MAP_PRIORITY

    choice CAMERA_OV02C10_IPA_JSON_CONFIGURATION_FILE
        prompt "IPA Configuration File"
        default CAMERA_OV02C10_DEFAULT_IPA_JSON_CONFIGURATION_FILE
        help
            Select the Image Processing Algorithm (IPA) JSON configuration file
            for the OV02C10 sensor.

        config CAMERA_OV02C10_DEFAULT_IPA_JSON_CONFIGURATION_FILE
            bool "Use default configuration"
            help
                Use the built-in default IPA configuration file:
                "esp_cam_sensor/sensors/ov02c10/cfg/ov02c10_default.json"

                This configuration provides optimized settings for general use cases
                and is recommended for most applications.

        config CAMERA_OV02C10_CUSTOMIZED_IPA_JSON_CONFIGURATION_FILE
            bool "Use custom configuration"
            help
                Use a custom IPA configuration file with your own optimized settings.

                This option allows you to fine-tune sensor parameters for specific
                lighting conditions, color requirements, or application needs.

                You must specify the custom file path in the configuration below.
    endchoice

    config CAMERA_OV02C10_CUSTOMIZED_IPA_JSON_CONFIGURATION_FILE_PATH
        string "Custom IPA configuration file path"
        depends on CAMERA_OV02C10_CUSTOMIZED_IPA_JSON_CONFIGURATION_FILE
        help
            Specify the path to your custom OV02C10 IPA JSON configuration file.

            The path is relative to your project root directory.

            Example: "components/my_camera_config/ov02c10_custom.json"

            Ensure the file exists and contains valid JSON configuration
            parameters compatible with the OV02C10 sensor.
endif
```
