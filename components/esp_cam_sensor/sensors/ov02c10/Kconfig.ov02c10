## main/Kconfig.projbuild
```kconfig
# SPDX-License-Identifier: LicenseRef-FNCL-1.1
# Copyright (c) 2026 Cpt_Kirk
# Modified 2026 by andre68723 in the andre68723/BETTA-HA-PANEL fork, see docs/release-notes.md
menu "Example Configuration"

menu "LVGL memory"

config APP_LVGL_ALLOC_PSRAM_FIRST
    bool "Allocate LVGL memory from PSRAM first (needs CONFIG_LV_USE_CUSTOM_MALLOC)"
    default n
    help
        Only has an effect when LVGL uses its custom allocator (set in config/sdkconfig.defaults for every variant):
        every LVGL allocation then tries PSRAM first and falls back to internal RAM. Off keeps the
        default heap policy (small blocks go to internal RAM first, see SPIRAM_MALLOC_ALWAYSINTERNAL).

endmenu

config APP_DISPLAY_PPA
    bool "Use PPA for shared display rotation"
    default y
    help
        Shared adapter bitmap rotation uses a bounded PPA transaction. Disable
        for boards using CPU rotation, including the original JC panel.

menu "OTA test hook"

config APP_AUTO_UPDATE_TEST_HOOK
    bool "Test hook for the automatic update (never in a release)"
    default n
    help
        Adds POST /api/ota/auto-update-test, which lets a test force the automatic update's night window and quiet
        panel, clear its stored state and fake a started attempt, so the install and the rollback can be exercised on a device
        in minutes. Only for test builds (config/sdkconfig.defaults.autoupdate_test); release images must not have it.

endmenu

menu "Panel Hardware Variant"

choice APP_PANEL_VARIANT
    prompt "Display panel variant"
    default APP_PANEL_VARIANT_4INCH_720
    help
        Select the physical LCD / touch panel this firmware image targets.
        Affects screen resolution (APP_SCREEN_WIDTH/HEIGHT), panel init
        sequence and touch-controller driver selection.

config APP_PANEL_VARIANT_4INCH_720
    bool "4\" 720x720 round (smart86 base)"
    help
        Original smart86 4-inch 720x720 square/round panel.

config APP_PANEL_VARIANT_10INCH_1280
    bool "10.1\" 1280x800 (betta large)"
    help
        10.1-inch 1280x800 panel variant.

config APP_PANEL_VARIANT_10INCH_JC
    bool "10.1\" 800x1280 (Guition JC8012P4A1, ESP32-P4)"
    help
        Guition JC8012P4A1 10.1-inch 800x1280 MIPI-DSI panel.
        Display: JD9365 controller, 2-lane MIPI-DSI.
        Touch: GSL3680 (Silead) I2C capacitive.
        Wi-Fi: ESP-Hosted (ESP32-P4 host + ESP32-C6 coprocessor, same as panel4/panel10).
        Native portrait 800x1280; LVGL rotation 90deg yields landscape 1280x800.

config APP_PANEL_VARIANT_TAB5_1280
    bool "5\" 1280x720 (M5Stack Tab5, ESP32-P4) - untested on hardware"
    help
        M5Stack Tab5, 5-inch 1280x720 landscape, ESP32-P4 + ESP32-C6 (ESP-Hosted).
        Display and touch come from Espressif's m5stack_tab5 BSP, Wi-Fi from ESP-Hosted over SDIO.
        Builds with `scripts/build.sh tab5 build`; NOT YET RUN ON HARDWARE (docs/hardware.md).

endchoice

config APP_PANELJC_PANEL_V2
    bool "JC8012P4A1 'V2' panel revision (JD9365 init table)"
    depends on APP_PANEL_VARIANT_10INCH_JC
    default n
    help
        The Guition JC8012P4A1(C) ships with at least two, probably three,
        physically different display panels under the same model number,
        identified by a 4-digit date code (YYWW = year + ISO week) printed
        on the rear case sticker:

          - date code up to ~2627: "V1" / original panel (default, this
            option OFF). This is what the default paneljc init table in
            main/drivers/display_init_paneljc.c targets.
          - date code ~2628 and up: "V2" panel. Needs a different JD9365
            gamma/GOA init table and different DSI/DPI timing. Enable this
            option for V2 hardware.
          - date code 2633+: reported as a further "V3" revision that is
            NOT supported by this firmware yet (black screen even with V2
            firmware in third-party projects). Do not enable this option
            for a V3-dated unit.

        The date-code cutoff is strong evidence, not a guarantee -- at
        least one report exists of a 2627-dated unit that actually needed
        V1 firmware. If the wrong option produces a black or garbled
        screen, try the other one.

        Touch (GSL3680) is identical between V1 and V2 and is unaffected
        by this option.

        See docs/hardware.md ("JC8012P4A1 panel revisions") for the full
        background, or build with the "paneljc-v2" CMake preset /
        config/sdkconfig.defaults.paneljc.v2 overlay instead of setting this by
        hand.

endmenu

menu "Ambient camera"

config APP_FEATURE_AMBIENT_CAMERA
    bool "Use the built-in camera as ambient light / presence sensor"
    default n
    depends on APP_PANEL_VARIANT_10INCH_JC || APP_PANEL_VARIANT_TAB5_1280
    help
        Duty-cycled capture of a few frames every few seconds, reduced to a
        luma grid. No streaming, no JPEG, nothing leaves the device.

endmenu

menu "Easter egg"

config APP_BETTA_EASTER_EGG
    bool "Swimming betta fish (7 taps on the navigation home button)"
    default n
    help
        Plays a Lottie animation of a betta fish. Needs the Lottie and ThorVG
        support of LVGL, which costs about 460 KB of flash (ThorVG, the animation
        and the C++ runtime), so it is off by default. Build with the overlay
        config/sdkconfig.defaults.easteregg to turn it on (it enables this option and
        CONFIG_LV_USE_LOTTIE / THORVG / VECTOR_GRAPHIC together).

endmenu

menu "Wi-Fi Station"

config APP_WIFI_SSID
    string "Wi-Fi SSID"
    default "YOUR_WIFI_SSID"
    help
        SSID of your access point.
        ESP32-C6 supports 2.4 GHz Wi-Fi.

config APP_WIFI_PASSWORD
    string "Wi-Fi Password"
    default "YOUR_WIFI_PASSWORD"
    help
        Password for your access point.
        Set empty only for open networks.

config APP_WIFI_COUNTRY_CODE
    string "Wi-Fi country code (ISO-3166 alpha-2)"
    default "US"
    help
        Two-letter country code used for Wi-Fi regulatory domain
        (for example US, DE, FR). This is used as default and can
        be overridden at runtime in provisioning/settings.

config APP_WIFI_WAIT_FOR_IP
    bool "Wait for IP before continuing boot"
    default y
    help
        If enabled, startup waits until station got IP or timeout.

config APP_WIFI_CONNECT_TIMEOUT_MS
    int "Wi-Fi connect timeout (ms)"
    range 1000 120000
    default 15000
    help
        Maximum time to wait for IP when wait-for-IP is enabled.

config APP_WIFI_MAX_RETRIES
    int "Wi-Fi max reconnect retries"
    range 1 100
    default 8
    help
        Number of reconnect attempts after disconnect.

config APP_WIFI_DISABLE_POWER_SAVE
    bool "Disable Wi-Fi power save (WIFI_PS_NONE)"
    default y
    help
        Forces Wi-Fi modem power-save off on the hosted C6 via esp_wifi_set_ps(WIFI_PS_NONE).
        Recommended for maximum websocket stability.

endmenu

menu "ESP-Hosted"

config APP_HOSTED_AUTO_UPDATE_C6_FW
    bool "Auto-update C6 firmware on version mismatch"
    default y
    depends on ESP_HOSTED_ENABLED
    help
        If enabled, the host runs automatic C6 slave OTA using the bundled
        firmware image whenever running C6 firmware differs from host version,
        including 0.0.0/unknown coprocessor firmware recovery.

endmenu

menu "Home Assistant"

config APP_HA_WS_URL
    string "HA WebSocket URL"
    default "YOUR_HA_WS_URL"
    help
        Example: wss://homeassistant.local:8123/api/websocket

config APP_HA_ACCESS_TOKEN
    string "HA Long-lived Access Token"
    default "YOUR_HA_ACCESS_TOKEN"
    help
        Long-lived access token used for Home Assistant authentication.

config APP_HA_FETCH_INITIAL_STATES
    bool "Fetch initial states after auth_ok"
    default y
    help
        When enabled, the device sends Home Assistant get_states right after
        websocket authentication. This can be memory-intensive on constrained
        links; keep disabled for maximum runtime stability.

config APP_HA_SUBSCRIBE_STATE_CHANGED
    bool "Subscribe to HA state_changed event stream"
    default y
    help
        Enables global Home Assistant state_changed subscription.
        This can produce high event volume; keep disabled while focusing
        on transport stability, then enable once stable.

config APP_HA_PING_INTERVAL_MS
    int "HA ping interval (ms)"
    range 5000 120000
    default 8000
    help
        Periodic Home Assistant websocket "ping" message interval.
        Keeps the application session active even during long idle periods.

endmenu

menu "Time"

config APP_NTP_SERVER
    string "NTP server"
    default "pool.ntp.org"
    help
        NTP server used for time synchronization.

config APP_TIME_TZ
    string "Timezone (POSIX TZ)"
    default "CET-1CEST,M3.5.0/2,M10.5.0/3"
    help
        POSIX timezone string used for localtime conversion.
        Default is Europe/Berlin with automatic DST switching.

endmenu

endmenu
```
