## sdkconfig.defaults.panel10
```kconfig
# SPDX-License-Identifier: LicenseRef-FNCL-1.1
# Copyright (c) 2026 Cpt_Kirk
#
# Panel variant overlay: 10.1" 1280x800 (Waveshare 10.1" MIPI-DSI).
# Apply together with the common sdkconfig.defaults via
#   idf.py -D SDKCONFIG_DEFAULTS="sdkconfig.defaults;sdkconfig.defaults.panel10" ...
# or the CMake preset "panel10" (see CMakePresets.json).

# --- Panel variant selector (drives app_config.h + display/touch init) ---
# CONFIG_APP_PANEL_VARIANT_4INCH_720 is not set
CONFIG_APP_PANEL_VARIANT_10INCH_1280=y

# PSRAM profile (Hex 200MHz) is shared across both variants and lives in
# sdkconfig.defaults. This overlay only carries 10.1"-specific tuning.

# (LV_USE_CLIB_MALLOC and MBEDTLS_SSL_IN_CONTENT_LEN=16384 live in the
#  common sdkconfig.defaults - both variants need them.)

# --- BSP display/touch: Waveshare 10.1" 800x1280 ---
CONFIG_BSP_LCD_COLOR_FORMAT_RGB565=y
# CONFIG_BSP_LCD_COLOR_FORMAT_RGB888 is not set
CONFIG_BSP_LCD_TYPE_800_1280_10_1_INCH=y
CONFIG_BSP_LCD_MIPI_DSI_LANE_BITRATE_MBPS=1500
CONFIG_ESP_LCD_TOUCH_MAX_POINTS=10
CONFIG_LV_USE_LODEPNG=y
```

## sdkconfig.defaults.panel4
```kconfig
# SPDX-License-Identifier: LicenseRef-FNCL-1.1
# Copyright (c) 2026 Cpt_Kirk
#
# Panel variant overlay: 4" 720x720 (original smart86 hardware).
# Apply together with the common sdkconfig.defaults via
#   idf.py -D SDKCONFIG_DEFAULTS="sdkconfig.defaults;sdkconfig.defaults.panel4" ...
# or the CMake preset "panel4" (see CMakePresets.json).
CONFIG_APP_PANEL_VARIANT_4INCH_720=y
# CONFIG_APP_PANEL_VARIANT_10INCH_1280 is not set

# --- BSP display/touch: Waveshare ESP32-P4-WIFI6-Touch-LCD-4B (800x800 3.4") ---
CONFIG_BSP_LCD_TYPE_800_800_3_4_INCH=y
CONFIG_ESP_LCD_TOUCH_MAX_POINTS=5
```

## sdkconfig.defaults.paneljc
```kconfig
# SPDX-License-Identifier: LicenseRef-FNCL-1.1
# Copyright (c) 2026 Cpt_Kirk
#
# Panel variant overlay: Guition JC8012P4A1 (ESP32-P4 + JD9365 MIPI-DSI 800x1280).
# Apply together with the common sdkconfig.defaults via
#   idf.py -D SDKCONFIG_DEFAULTS="sdkconfig.defaults;sdkconfig.defaults.paneljc" ...
# or the CMake preset "paneljc" (see CMakePresets.json).
#
# Wi-Fi: ESP-Hosted (P4 host + C6 coprocessor over SDIO) — shared with panel4/panel10.
# Display: JD9365, 2-lane MIPI-DSI, 800x1280 native portrait.
#   LVGL rotation 270° yields 1280x800 landscape (same content box as panel10).
# Touch: GSL3680 (Silead), I2C, vendored driver.

# --- Panel variant selector (drives app_config.h + display/touch init) ---
CONFIG_APP_PANEL_VARIANT_10INCH_JC=y
# CONFIG_APP_PANEL_VARIANT_4INCH_720 is not set
# CONFIG_APP_PANEL_VARIANT_10INCH_1280 is not set

# --- Flash sizing and partitions ---
CONFIG_ESPTOOLPY_FLASHSIZE_16MB=y
# CONFIG_ESPTOOLPY_FLASHSIZE_32MB is not set
CONFIG_PARTITION_TABLE_CUSTOM_FILENAME="partitions.paneljc.csv"
CONFIG_PARTITION_TABLE_FILENAME="partitions.paneljc.csv"

# --- Touch ---
CONFIG_ESP_LCD_TOUCH_MAX_POINTS=5

# --- JC8012P4A1 stability tuning ---
# Guition JC8012P4A1 boards in the wild are still commonly ESP32-P4 rev v1.x
# engineering samples. ESP-IDF treats P4 rev <3 and rev >=3 images as mutually
# exclusive, so build this variant for the v1.x silicon family.
CONFIG_ESP32P4_SELECTS_REV_LESS_V3=y
CONFIG_ESP32P4_REV_MIN_100=y
# CONFIG_ESP32P4_REV_MIN_300 is not set
# CONFIG_ESP32P4_REV_MIN_301 is not set

# The GSL3680 firmware upload and native OTA preparation can block long enough
# to trip the default 10s task watchdog on this panel.
CONFIG_ESP_TASK_WDT_TIMEOUT_S=60
CONFIG_ESP_MAIN_TASK_STACK_SIZE=8192
# Match the known-good ESPHome JC8012P4A1 SDIO profile.
CONFIG_ESP_HOSTED_SDIO_CLOCK_FREQ_KHZ=20000
# ESP-Hosted static mempool can exhaust internal DMA memory before display init.
# CONFIG_ESP_HOSTED_USE_MEMPOOL is not set
# Avoid long native OTA flash preparation stalls before upload progress starts.
# CONFIG_SPI_FLASH_YIELD_DURING_ERASE is not set

# --- Image support ---
CONFIG_LV_USE_LODEPNG=y

# The production firmware does not call LVGL examples; keeping them enabled
# compiles hundreds of unused sources and slows paneljc builds noticeably.
# CONFIG_LV_BUILD_EXAMPLES is not set
```

## sdkconfig.defaults.panels3
```kconfig
# SPDX-License-Identifier: LicenseRef-FNCL-1.1
# Copyright (c) 2026 Cpt_Kirk
#
# Panel variant overlay: 4" 480x480 (Guition CYD ESP32-S3 4848S040).
# Apply together with sdkconfig.defaults.s3 via
#   idf.py -D SDKCONFIG_DEFAULTS="sdkconfig.defaults.s3;sdkconfig.defaults.panels3" ...
# or the CMake preset "panels3" (see CMakePresets.json).

# --- Panel variant selector (drives app_config.h + display/touch init) ---
CONFIG_APP_PANEL_VARIANT_S3_480=y
# CONFIG_APP_PANEL_VARIANT_4INCH_720 is not set
# CONFIG_APP_PANEL_VARIANT_10INCH_1280 is not set

# --- Touch controller (GT911 capacitive on most CYD 4848S040 batches) ---
CONFIG_ESP_LCD_TOUCH_MAX_POINTS=5
```

## sdkconfig.defaults.s3
```kconfig
# SPDX-License-Identifier: LicenseRef-FNCL-1.1
# Copyright (c) 2026 Cpt_Kirk
#
# Base defaults for the ESP32-S3 panel variants.
# Replaces the P4-centric sdkconfig.defaults: native Wi-Fi (no ESP-Hosted),
# Octal PSRAM @80MHz instead of Hex@200MHz, no PPA hardware accelerator.
#
# Apply together with a panel-specific overlay, e.g.
#   idf.py -D SDKCONFIG_DEFAULTS="sdkconfig.defaults.s3;sdkconfig.defaults.panels3" ...
# or via the CMake preset "panels3" (see CMakePresets.json).

# --- SoC target ---
CONFIG_IDF_TARGET="esp32s3"

# --- Core behavior defaults (mirrors sdkconfig.defaults common section) ---
CONFIG_LOG_DEFAULT_LEVEL_INFO=y
CONFIG_FREERTOS_HZ=1000
CONFIG_ESP_TASK_WDT_TIMEOUT_S=10
CONFIG_ESP_MAIN_TASK_STACK_SIZE=6144

# --- Flash sizing (typical Guition CYD 4848S040: 16MB) ---
CONFIG_ESPTOOLPY_FLASHSIZE_16MB=y

# --- Custom partition table (smaller OTA slots than P4 due to 16MB flash) ---
# CONFIG_PARTITION_TABLE_SINGLE_APP is not set
CONFIG_PARTITION_TABLE_CUSTOM=y
CONFIG_PARTITION_TABLE_CUSTOM_FILENAME="partitions.s3.csv"
CONFIG_PARTITION_TABLE_FILENAME="partitions.s3.csv"

# --- Native Wi-Fi (no ESP-Hosted) ---
# ESP-Hosted is not pulled in for panels3, so its Kconfig symbols don't exist.
# Native ESP32-S3 Wi-Fi + AP support is on by default.
CONFIG_ESP_WIFI_SOFTAP_SUPPORT=y

# S3 low-RAM profile: enough for HA WebSocket + HTTP setup UI, but much
# lighter than the P4/C6-hosted defaults.
CONFIG_LWIP_TCPIP_RECVMBOX_SIZE=16
CONFIG_LWIP_TCP_RECVMBOX_SIZE=16
CONFIG_LWIP_UDP_RECVMBOX_SIZE=16
CONFIG_LWIP_MAX_SOCKETS=16
CONFIG_LWIP_TCP_MSS=1200
CONFIG_LWIP_TCP_SND_BUF_DEFAULT=8192
CONFIG_LWIP_TCP_WND_DEFAULT=8192
CONFIG_LWIP_TCP_SACK_OUT=y

# Native ESP32-S3 Wi-Fi buffers. 16 dynamic RX/TX buffers is still generous
# for a single WebSocket client and prevents Wi-Fi from eating the heap before
# the application tasks start.
CONFIG_ESP_WIFI_STATIC_RX_BUFFER_NUM=8
CONFIG_ESP_WIFI_DYNAMIC_RX_BUFFER_NUM=16
CONFIG_ESP_WIFI_DYNAMIC_TX_BUFFER_NUM=16

# --- PSRAM profile (Octal @80MHz; Guition 4848S040 ships with OPI 8MB) ---
# Some CYD batches ship Quad PSRAM instead — if boot fails with Octal,
# switch to CONFIG_SPIRAM_MODE_QUAD locally and re-flash.
CONFIG_SPIRAM=y
CONFIG_SPIRAM_MODE_OCT=y
CONFIG_SPIRAM_SPEED_80M=y
CONFIG_SPIRAM_FETCH_INSTRUCTIONS=y
CONFIG_SPIRAM_RODATA=y
CONFIG_SPIRAM_USE_MALLOC=y
CONFIG_SPIRAM_BOOT_INIT=y
CONFIG_FREERTOS_TASK_CREATE_ALLOW_EXT_MEM=y
CONFIG_SPIRAM_MALLOC_ALWAYSINTERNAL=1024
CONFIG_SPIRAM_MALLOC_RESERVE_INTERNAL=49152

# --- LVGL allocator ---
# CONFIG_LV_USE_BUILTIN_MALLOC is not set
CONFIG_LV_USE_CLIB_MALLOC=y

# --- mbedTLS tuning (matches P4 defaults; HA WS reuse) ---
CONFIG_MBEDTLS_DYNAMIC_BUFFER=y
CONFIG_MBEDTLS_SSL_IN_CONTENT_LEN=16384
CONFIG_MBEDTLS_SSL_OUT_CONTENT_LEN=2048
CONFIG_MBEDTLS_EXTERNAL_MEM_ALLOC=y
# CONFIG_MBEDTLS_INTERNAL_MEM_ALLOC is not set
CONFIG_MBEDTLS_DYNAMIC_FREE_CONFIG_DATA=y
# CONFIG_MBEDTLS_SSL_KEEP_PEER_CERTIFICATE is not set
CONFIG_MBEDTLS_CERTIFICATE_BUNDLE=y
CONFIG_MBEDTLS_CERTIFICATE_BUNDLE_DEFAULT_FULL=y
CONFIG_MBEDTLS_CLIENT_SSL_SESSION_TICKETS=y
CONFIG_ESP_WS_CLIENT_SEPARATE_TX_LOCK=y

# --- App defaults ---
CONFIG_APP_WIFI_DISABLE_POWER_SAVE=y
CONFIG_APP_HA_FETCH_INITIAL_STATES=y
CONFIG_APP_HA_SUBSCRIBE_STATE_CHANGED=y
CONFIG_APP_HA_PING_INTERVAL_MS=30000

# --- LVGL features ---
# Lottie/ThorVG is too heap-hungry and the Meteocons Lottie assets are too
# complex to rasterize cleanly at the small icon sizes available on the S3
# 480x480 panel (~96 px max).  Weather tiles use static MDI icons on panels3;
# keep animated assets for P4 builds only.
# CONFIG_LV_USE_VECTOR_GRAPHIC is not set
# CONFIG_LV_USE_LOTTIE is not set
# CONFIG_LV_USE_THORVG is not set
# CONFIG_LV_USE_THORVG_INTERNAL is not set
CONFIG_LV_USE_LODEPNG=y
CONFIG_LV_USE_FLOAT=y
CONFIG_LV_USE_MATRIX=y

# --- RGB LCD driver (Phase 2: ST7701S parallel RGB panel) ---
# Explicitly disable IRAM-safe ISR: the Kconfig default is =y on S3, but
# esp_lvgl_port v2.7.x registers lvgl_port_flush_rgb_vsync_ready_callback
# without IRAM_ATTR, causing an abort at runtime when =y.
# We don't need it: no flash writes happen during display refresh.
# CONFIG_LCD_RGB_ISR_IRAM_SAFE is not set
# Restart the RGB GDMA stream at each VBlank. This keeps the ST7701S from
# staying permanently offset if PSRAM bandwidth briefly starves the bounce
# buffer, which otherwise shows up as faint vertical/shift artifacts.
CONFIG_LCD_RGB_RESTART_IN_VSYNC=y

# --- Display/LVGL profile (no PPA on S3, software path only) ---
# PPA hardware accelerator does not exist on ESP32-S3.
# CONFIG_LVGL_PORT_ENABLE_PPA is not set
CONFIG_SPIRAM_XIP_FROM_PSRAM=y
# BSP_DISPLAY_LVGL_* symbols come from the Waveshare BSP packages used by
# panel4/panel10 — they don't exist on panels3 (no BSP). Tearing mitigation
# is implemented inline in main/drivers/display_init_panels3.c (Phase 2).
CONFIG_LV_DEF_REFR_PERIOD=33

# --- Fonts (matches P4 defaults; can be trimmed in Phase 3 if size pressure) ---
CONFIG_LV_FONT_MONTSERRAT_20=y
CONFIG_LV_FONT_MONTSERRAT_22=y
CONFIG_LV_FONT_MONTSERRAT_28=y
CONFIG_LV_FONT_MONTSERRAT_34=y
CONFIG_LV_FONT_FMT_TXT_LARGE=y
CONFIG_LV_TXT_BREAK_CHARS=" ,.;:-_"
CONFIG_LV_USE_SNAPSHOT=y

# --- CPU frequency (S3 max is 240 MHz) ---
CONFIG_ESP_DEFAULT_CPU_FREQ_MHZ_240=y
CONFIG_ESP_DEFAULT_CPU_FREQ_MHZ=240
```
